## CMOS74/main/Kconfig.projbuild
```kconfig
menu "UART Command Configuration"

    orsource "$IDF_PATH/examples/common_components/env_caps/$IDF_TARGET/Kconfig.env_caps"

    config COMMAND_UART_PORT_NUM
        int "UART port number"
        range 0 2 if IDF_TARGET_ESP32 || IDF_TARGET_ESP32S3
        default 2 if IDF_TARGET_ESP32 || IDF_TARGET_ESP32S3
        range 0 1
        default 1
        help
            UART communication port number for the example.
            See UART documentation for available port numbers.

    config COMMAND_UART_BAUD_RATE
        int "UART communication speed"
        range 1200 115200
        default 115200
        help
            UART communication speed for Modbus example.

    config COMMAND_UART_RXD
        int "UART RXD pin number"
        range ENV_GPIO_RANGE_MIN ENV_GPIO_IN_RANGE_MAX
        default 5
        help
            GPIO number for UART RX pin. See UART documentation for more information
            about available pin numbers for UART.

    config COMMAND_UART_TXD
        int "UART TXD pin number"
        range ENV_GPIO_RANGE_MIN ENV_GPIO_OUT_RANGE_MAX
        default 4
        help
            GPIO number for UART TX pin. See UART documentation for more information
            about available pin numbers for UART.

    config COMMAND_TASK_STACK_SIZE
        int "UART task stack size"
        range 1024 16384
        default 3072
        help
            Defines stack size for UART echo example. Insufficient stack size can cause crash.

endmenu

menu "Cpu Led1 Configuration"

    choice LED1_RED
        prompt "Blink LED1 RED type"
        default LED1_RED_GPIO
        help
            Select the LED type. A normal level controlled LED or an addressable LED strip.
            The default selection is based on the Espressif DevKit boards.
            You can change the default selection according to your board.

        config LED1_RED_GPIO
            bool "GPIO"
        config LED1_RED_STRIP
            bool "LED strip"
    endchoice

    choice BLINK_LED1_RED_STRIP_BACKEND
        depends on BLINK_LED_STRIP
        prompt "LED strip backend peripheral"
        default BLINK_LED1_RED_STRIP_BACKEND_RMT if SOC_RMT_SUPPORTED
        default BLINK_LED1_RED_STRIP_BACKEND_SPI
        help
            Select the backend peripheral to drive the LED strip.

        config BLINK_LED1_RED_STRIP_BACKEND_RMT
            depends on SOC_RMT_SUPPORTED
            bool "RMT"
        config BLINK_LED1_RED_STRIP_BACKEND_SPI
            bool "SPI"
    endchoice

    config LED1_RED_GPIO
        int "Blink GPIO number"
        range ENV_GPIO_RANGE_MIN ENV_GPIO_OUT_RANGE_MAX
        default 4
        help
            GPIO number (IOxx) to blink on and off the LED.
            Some GPIOs are used for other purposes (flash connections, etc.) and cannot be used to blink.

    config LED1_RED_PERIOD
        int "Blink period in ms"
        range 10 3600000
        default 1000
        help
            Define the blinking period in milliseconds.

    config LED1_RED_RATIO
        int "Ratio period in %"
        range 0 100
        default 50
        help
            Define pourcentage of the blinking period


    choice LED1_GREEN
        prompt "Blink LED1 GREEN type"
        default LED1_GREEN_GPIO
        help
            Select the LED type. A normal level controlled LED or an addressable LED strip.
            The default selection is based on the Espressif DevKit boards.
            You can change the default selection according to your board.

        config LED1_GREEN_GPIO
            bool "GPIO"
        config LED1_GREEN_STRIP
            bool "LED strip"
    endchoice

    choice BLINK_LED1_GREEN_STRIP_BACKEND
        depends on BLINK_LED_STRIP
        prompt "LED strip backend peripheral"
        default BLINK_LED1_GREEN_STRIP_BACKEND_RMT if SOC_RMT_SUPPORTED
        default BLINK_LED1_GREEN_STRIP_BACKEND_SPI
        help
            Select the backend peripheral to drive the LED strip.

        config BLINK_LED1_GREEN_STRIP_BACKEND_RMT
            depends on SOC_RMT_SUPPORTED
            bool "RMT"
        config BLINK_LED1_GREEN_STRIP_BACKEND_SPI
            bool "SPI"
    endchoice

    config LED1_GREEN_GPIO
        int "Blink GPIO number"
        range ENV_GPIO_RANGE_MIN ENV_GPIO_OUT_RANGE_MAX
        default 2
        help
            GPIO number (IOxx) to blink on and off the LED.
            Some GPIOs are used for other purposes (flash connections, etc.) and cannot be used to blink.

    config LED1_GREEN_PERIOD
        int "Blink period in ms"
        range 10 3600000
        default 1000
        help
            Define the blinking period in milliseconds.

    config LED1_GREEN_RATIO
        int "Ratio period in %"
        range 0 100
        default 50
        help
            Define pourcentage of the blinking period

endmenu

menu "Cpu Led2 Configuration"

    choice LED2_RED
        prompt "Blink LED2 RED type"
        default LED2_RED_GPIO
        help
            Select the LED type. A normal level controlled LED or an addressable LED strip.
            The default selection is based on the Espressif DevKit boards.
            You can change the default selection according to your board.

        config LED2_RED_GPIO
            bool "GPIO"
        config LED2_RED_STRIP
            bool "LED strip"
    endchoice

    choice BLINK_LED2_RED_STRIP_BACKEND
        depends on BLINK_LED_STRIP
        prompt "LED strip backend peripheral"
        default BLINK_LED2_RED_STRIP_BACKEND_RMT if SOC_RMT_SUPPORTED
        default BLINK_LED2_RED_STRIP_BACKEND_SPI
        help
            Select the backend peripheral to drive the LED strip.

        config BLINK_LED2_RED_STRIP_BACKEND_RMT
            depends on SOC_RMT_SUPPORTED
            bool "RMT"
        config BLINK_LED2_RED_STRIP_BACKEND_SPI
            bool "SPI"
    endchoice

    config LED2_RED_GPIO
        int "Blink GPIO number"
        range ENV_GPIO_RANGE_MIN ENV_GPIO_OUT_RANGE_MAX
        default 12
        help
            GPIO number (IOxx) to blink on and off the LED.
            Some GPIOs are used for other purposes (flash connections, etc.) and cannot be used to blink.

    config LED2_RED_PERIOD
        int "Blink period in ms"
        range 10 3600000
        default 1000
        help
            Define the blinking period in milliseconds.

    config LED2_RED_RATIO
        int "Ratio period in %"
        range 0 100
        default 50
        help
            Define pourcentage of the blinking period


    choice LED2_GREEN
        prompt "Blink LED2 GREEN type"
        default LED2_GREEN_GPIO
        help
            Select the LED type. A normal level controlled LED or an addressable LED strip.
            The default selection is based on the Espressif DevKit boards.
            You can change the default selection according to your board.

        config LED2_GREEN_GPIO
            bool "GPIO"
        config LED2_GREEN_STRIP
            bool "LED strip"
    endchoice

    choice BLINK_LED2_GREEN_STRIP_BACKEND
        depends on BLINK_LED_STRIP
        prompt "LED strip backend peripheral"
        default BLINK_LED2_GREEN_STRIP_BACKEND_RMT if SOC_RMT_SUPPORTED
        default BLINK_LED2_GREEN_STRIP_BACKEND_SPI
        help
            Select the backend peripheral to drive the LED strip.

        config BLINK_LED2_GREEN_STRIP_BACKEND_RMT
            depends on SOC_RMT_SUPPORTED
            bool "RMT"
        config BLINK_LED2_GREEN_STRIP_BACKEND_SPI
            bool "SPI"
    endchoice

    config LED2_GREEN_GPIO
        int "Blink GPIO number"
        range ENV_GPIO_RANGE_MIN ENV_GPIO_OUT_RANGE_MAX
        default 5
        help
            GPIO number (IOxx) to blink on and off the LED.
            Some GPIOs are used for other purposes (flash connections, etc.) and cannot be used to blink.

    config LED2_GREEN_PERIOD
        int "Blink period in ms"
        range 10 3600000
        default 1000
        help
            Define the blinking period in milliseconds.

    config LED2_GREEN_RATIO
        int "Ratio period in %"
        range 0 100
        default 50
        help
            Define pourcentage of the blinking period

endmenu

menu "Clock Configuration"

    choice PCF8563
        prompt "PCF8563 type"
        default PCF8563_GPIO
        help
           To do
        config PCF8563_GPIO
            bool "PCF8563"
        config TCAXXX_GPIO
            bool "TCAXXX"
    endchoice

    config CLOCK_GPIO
        int "I2C port number"
        range 0 2
        default 2
        help
            GPIO number (IOxx) to blink on and off the LED.
            Some GPIOs are used for other purposes (flash connections, etc.) and cannot be used to blink.

    config CLOCK_PERIOD
        int "Clock period in ms"
        range 1 3600000
        default 3600000
        help
            Define the refresh period in milliseconds.

    
endmenu

menu "Sensor Configuration"

    choice SENSOR
        prompt "Sensor type"
        default GY511_GPIO
        help
           To do
        config GY511_GPIO
            bool "GY511"
        config GYXXX_GPIO
            bool "GYXXX"
    endchoice

    config SENSOR_GPIO
        int "I2C port number"
        range 0 2
        default 2
        help
            GPIO number (IOxx) to drive the SENSOR.

    config SENSOR_PERIOD
        int "Sensor period in ms"
        range 1 3600000
        default 3600000
        help
            Define the refresh period in milliseconds.

    
endmenu

menu "Oled Configuration"

    choice LCD_CONTROLLER
        prompt "LCD controller model"
        default LCD_CONTROLLER_SSD1306
        help
            Select LCD controller model

        config LCD_CONTROLLER_SSD1306
            bool "SSD1306"

        config LCD_CONTROLLER_SH1107
            bool "SH1107"
    endchoice

    if LCD_CONTROLLER_SSD1306
        choice SSD1306_HEIGHT
            prompt "SSD1306 Height in pixels"
            default SSD1306_HEIGHT_32
            help
                Height of the display in pixels. a.k.a vertical resolution

            config SSD1306_HEIGHT_64
                bool "64"
            config SSD1306_HEIGHT_32
                bool "32"
        endchoice

        config SSD1306_HEIGHT
            int
            default 64 if SSD1306_HEIGHT_64
            default 32 if SSD1306_HEIGHT_32
    endif

endmenu
```
